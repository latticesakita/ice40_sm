# iCE40UP5K register map
Vendor: Latticsemi.com; Series: iCE40UP; File version: 1.0
ice40_sm
Registers are 2-bit, read-write, reset 0x0 unless marked. A register's access mark holds for its fields unless they carry their own. Offsets are from the block's base; lines under a group give offsets from that group; [hi:lo] are bit positions; {n}, {i} and the like mark numbered series; 'fields as' and 'values as' point back to an identical list; <NAME> marks a mode.

## Memory map
0x00000000 system0_inst size 0x20000
0x00020000 system1_inst size 0x20000
0x00040000 gpio_inst size 0x400
0x00050000 ice40_ip_if_inst size 0x400
0x00060000 timer_inst size 0x400
0x00070000 uart_inst size 0x400
0xFFFF0000 cpu_inst size 0x800

## cpu_inst
Base 0xFFFF0000
0x00 PIC_STATUS — Interrupt Status Register
  [1:0] status — Interrupt Status
0x04 PIC_ENABLE — Interrupt Enable Register
  [1:0] enable — Interrupt Enable
0x08 PIC_SET wo — Interrupt Set Register
  [1:0] set — Interrupt Set
0x0C PIC_POL — Interrupt Polarity Register
  [1:0] pol — Interrupt Polarity
0x400 TIMER_CNT_L 32-bit — Timer Counter Lower Register
  [31:0] cnt_l — Lower 32 bits of 64-bit timer counter register
0x404 TIMER_CNT_H 32-bit — Timer Counter Higher Register
  [31:0] cnt_h — Higher 32 bits of 64-bit timer counter register
0x410 TIMER_CMP_L 32-bit — Timer Compare Lower Register
  [31:0] cmp_l — Lower 32 bits of 64-bit timer compare register
0x414 TIMER_CMP_H 32-bit — Timer Compare Higher Register
  [31:0] cmp_h — Higher 32 bits of 64-bit timer compare register
